## conf/distro/orhun-linux.conf
```bitbake
DISTRO = "orhun-linux"
DISTRO_NAME = "Orhun Custom GUI OS"
DISTRO_VERSION = "0.1"

DISTRO_FEATURES:append = " x11 opengl systemd usrmerge"

# Enforce systemd as the primary init manager for the entire distro
VIRTUAL-RUNTIME_init_manager = "systemd"
DISTRO_FEATURES_BACKFILL_CONSIDERED += "sysvinit"
VIRTUAL-RUNTIME_initscripts = "systemd-compat-units"

VIRTUAL-RUNTIME_graphical_init_manager = "lxdm"
SYSTEMD_DEFAULT_TARGET = "graphical.target"
```

## conf/layer.conf
```bitbake
BBPATH .= ":${LAYERDIR}"

BBFILES += "${LAYERDIR}/recipes-*/*/*.bb \
            ${LAYERDIR}/recipes-*/*/*.bbappend"

BBFILE_COLLECTIONS += "meta-orhun-gui"
BBFILE_PATTERN_meta-orhun-gui = "^${LAYERDIR}/"
BBFILE_PRIORITY_meta-orhun-gui = "6"

LAYERDEPENDS_meta-orhun-gui = "core"
LAYERSERIES_COMPAT_meta-orhun-gui = "whinlatter"
```
